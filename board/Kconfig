## board/Kconfig
```kconfig
menu "Hardware Drivers Config"


	
menu "Onboard Peripheral Drivers"
config SOC_SERIES_GD32F30x
    bool
    default y
	
config SOC_GD32303Z
    bool
    select SOC_SERIES_GD32F30x
    select RT_USING_COMPONENTS_INIT
    select RT_USING_USER_MAIN
    default y
endmenu

menu "On-chip Peripheral Drivers"

    config BSP_USING_GPIO
        bool "Enable GPIO"
        select RT_USING_PIN
        default y
	menuconfig BSP_USING_ADC
		bool "Enable ADC"
		default n
		select RT_USING_ADC
		if BSP_USING_ADC
			config BSP_USING_ADC0
			bool "Enable ADC0"
			default y
			
			config BSP_ADC0_USING_DMA
			bool "Enable adc0 DMA"
			select RT_USING_DMA
			depends on BSP_USING_ADC0
			default n
		
			config  BSP_USING_ADC1
			bool "Enable ADC1"
			default n
			
			config BSP_ADC1_USING_DMA
			bool "Enable adc1 DMA"
			select RT_USING_DMA
			depends on BSP_USING_ADC1
			default n
			
		endif
			
    menuconfig BSP_USING_UART
        bool "Enable UART"
        default y
        select RT_USING_SERIAL
        if BSP_USING_UART
            config BSP_USING_UART0
                bool "Enable UART0"
                default y

            config BSP_UART0_RX_USING_DMA
                bool "Enable UART0 RX DMA"
				select RT_USING_DMA
                depends on BSP_USING_UART0 && RT_SERIAL_USING_DMA
                default n
				
            config BSP_USING_UART1
                bool "Enable UART1"
                default y

            config BSP_UART1_RX_USING_DMA
                bool "Enable UART1 RX DMA"
				select RT_USING_DMA
                depends on BSP_USING_UART1 && RT_SERIAL_USING_DMA
                default n
				
			 config BSP_USING_UART2
                bool "Enable UART2"
                default y

            config BSP_UART2_RX_USING_DMA
                bool "Enable UART2 RX DMA"
				select RT_USING_DMA
                depends on BSP_USING_UART2 && RT_SERIAL_USING_DMA
                default n
        endif

    menuconfig BSP_USING_SPI
        bool "Enable SPI BUS"
        default n
        select RT_USING_SPI
        if BSP_USING_SPI
            config BSP_USING_SPI1
                bool "Enable SPI1 BUS"
                default n

            config BSP_SPI1_TX_USING_DMA
                bool "Enable SPI1 TX DMA"
                depends on BSP_USING_SPI1
                default n
                
            config BSP_SPI1_RX_USING_DMA
                bool "Enable SPI1 RX DMA"
                depends on BSP_USING_SPI1
                select BSP_SPI1_TX_USING_DMA
                default n
        endif

    menuconfig BSP_USING_I2C1
        bool "Enable I2C1 BUS (software simulation)"
        default n
        select RT_USING_I2C
        select RT_USING_I2C_BITOPS
        select RT_USING_PIN
        if BSP_USING_I2C1
            config BSP_I2C1_SCL_PIN
                int "i2c1 scl pin number"
                range 1 216
                default 24
            config BSP_I2C1_SDA_PIN
                int "I2C1 sda pin number"
                range 1 216
                default 25
        endif
	 menuconfig BSP_USING_HWTIMER
		bool "Enable  HWTIMER"
		default n
		select RT_USING_HWTIMER
		if BSP_USING_HWTIMER
			config BSP_USING_HWTIMER0
			bool "enalbe hardware timer0"
			default n
			config BSP_USING_HWTIMER1
			bool "enalbe hardware timer1"
			default n
			config BSP_USING_HWTIMER2
			bool "enalbe hardware timer2"
			default n
			config BSP_USING_HWTIMER3
			bool "enalbe hardware timer3"
			default n
		endif
		
    source "libraries/gd32_drivers/Kconfig"
    
endmenu

menu "Board extended module Drivers"

endmenu
 
endmenu
```
